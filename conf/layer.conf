## conf/layer.conf
```bitbake
# We have a conf and classes directory, append to BBPATH
BBPATH .= ":${LAYERDIR}"

# We have a recipes directory, add to BBFILES
BBFILES += "${LAYERDIR}/recipes*/*/*.bb ${LAYERDIR}/recipes*/*/*.bbappend"

BBFILE_COLLECTIONS += "meta-edgeml"
BBFILE_PATTERN:meta-edgeml := "^${LAYERDIR}/"
BBFILE_PRIORITY:meta-edgeml = "6"

LAYERVERSION:meta-edgeml = "1"
LAYERDEPENDS:meta-edgeml = "core"
LAYERSERIES:COMPAT:meta-edgeml = "gatesgarth hardknott"
```
